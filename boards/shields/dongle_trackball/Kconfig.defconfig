## boards/shields/dongle_trackball/Kconfig.defconfig
```kconfig
if SHIELD_DONGLE_TRACKBALL

config ZMK_KEYBOARD_NAME
    default "Trackball Dongle"

config ZMK_SPLIT
    default y

config ZMK_SPLIT_ROLE_CENTRAL
    default y

config ZMK_POINTING
    default y

endif
```

## boards/shields/dongle_trackball/Kconfig.shield
```kconfig
config SHIELD_DONGLE_TRACKBALL
    def_bool $(shields_list_contains,dongle_trackball)
```
